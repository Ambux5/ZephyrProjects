## CMakeLists.txt
```
cmake_minimum_required(VERSION 3.20.0)
find_package(Zephyr REQUIRED HINTS $ENV{ZEPHYR_BASE})
project(usb_webserver)

# Read Zephyr version
file(READ "${ZEPHYR_BASE}/VERSION" ZEPHYR_VERSION_FILE)
string(REGEX MATCH "VERSION_MAJOR = ([0-9]+)" _ "${ZEPHYR_VERSION_FILE}")
set(ZEPHYR_MAJOR ${CMAKE_MATCH_1})
string(REGEX MATCH "VERSION_MINOR = ([0-9]+)" _ "${ZEPHYR_VERSION_FILE}")
set(ZEPHYR_MINOR ${CMAKE_MATCH_1})
string(REGEX MATCH "PATCHLEVEL = ([0-9]+)" _ "${ZEPHYR_VERSION_FILE}")
set(ZEPHYR_PATCH ${CMAKE_MATCH_1})
set(ZEPHYR_VERSION_STRING "${ZEPHYR_MAJOR}.${ZEPHYR_MINOR}.${ZEPHYR_PATCH}")

# Application sources
target_sources(app PRIVATE
    src/main.c
    src/usb_service.c
    src/web_server.c
)

# Pass version to compiler (without quotes for stringify macro)
target_compile_definitions(app PRIVATE
    ZEPHYR_VERSION_STRING=${ZEPHYR_MAJOR}.${ZEPHYR_MINOR}.${ZEPHYR_PATCH}
)
```

## prj.conf
```kconfig
# Networking
CONFIG_NETWORKING=y
CONFIG_NET_IPV4=y
CONFIG_NET_TCP=y
CONFIG_NET_SOCKETS=y
CONFIG_NET_L2_ETHERNET=y
CONFIG_NET_IF_MAX_IPV4_COUNT=2
CONFIG_NET_IF_UNICAST_IPV4_ADDR_COUNT=1

# Static network configuration for USB ECM interface
CONFIG_NET_CONFIG_SETTINGS=y
CONFIG_NET_CONFIG_AUTO_INIT=y
CONFIG_NET_CONFIG_NEED_IPV4=y
CONFIG_NET_CONFIG_MY_IPV4_ADDR="192.0.2.1"
CONFIG_NET_CONFIG_MY_IPV4_NETMASK="255.255.255.0"
CONFIG_NET_CONFIG_PEER_IPV4_ADDR="192.0.2.2"

# Shell for debugging and network commands
CONFIG_SHELL=y
CONFIG_NET_SHELL=y

# USB Device with CDC ECM Ethernet
CONFIG_USB_DEVICE_STACK=y
CONFIG_USB_DEVICE_NETWORK_ECM=y
CONFIG_USB_DEVICE_PRODUCT="H723 USB Ethernet"
CONFIG_USB_DEVICE_MANUFACTURER="Zephyr"

# Network buffers
CONFIG_NET_PKT_RX_COUNT=32
CONFIG_NET_PKT_TX_COUNT=32
CONFIG_NET_BUF_RX_COUNT=64
CONFIG_NET_BUF_TX_COUNT=64

# Stack sizes
CONFIG_MAIN_STACK_SIZE=8192
CONFIG_SYSTEM_WORKQUEUE_STACK_SIZE=8192

# Logging with network debug
CONFIG_LOG=y
CONFIG_LOG_DEFAULT_LEVEL=3
CONFIG_NET_LOG=y
```

## prj-eth.conf
```kconfig
# Ethernet 
CONFIG_NETWORKING=y
CONFIG_NET_IPV4=y
CONFIG_NET_TCP=y
CONFIG_NET_L2_ETHERNET=y

# Static IP address
CONFIG_NET_CONFIG_SETTINGS=y
CONFIG_NET_CONFIG_MY_IPV4_ADDR="192.168.1.100"
CONFIG_NET_CONFIG_MY_IPV4_NETMASK="255.255.255.0"
CONFIG_NET_CONFIG_MY_IPV4_GW="192.168.1.1"

# Network buffers
CONFIG_NET_PKT_RX_COUNT=16
CONFIG_NET_PKT_TX_COUNT=16
CONFIG_NET_BUF_RX_COUNT=32
CONFIG_NET_BUF_TX_COUNT=32

# Stack size
CONFIG_MAIN_STACK_SIZE=4096
CONFIG_SYSTEM_WORKQUEUE_STACK_SIZE=4096

# Logging
CONFIG_LOG=y
CONFIG_LOG_DEFAULT_LEVEL=3
```

## prj-rndis.conf
```kconfig
# Networking
CONFIG_NETWORKING=y
CONFIG_NET_IPV4=y
CONFIG_NET_TCP=y
CONFIG_NET_SOCKETS=y
CONFIG_NET_L2_ETHERNET=y
CONFIG_NET_IF_MAX_IPV4_COUNT=2
CONFIG_NET_IF_UNICAST_IPV4_ADDR_COUNT=2

# Static network configuration for USB RNDIS interface
CONFIG_NET_CONFIG_SETTINGS=y
CONFIG_NET_CONFIG_NEED_IPV4=y
CONFIG_NET_CONFIG_MY_IPV4_ADDR="192.0.2.1"
CONFIG_NET_CONFIG_MY_IPV4_NETMASK="255.255.255.0"
CONFIG_NET_CONFIG_PEER_IPV4_ADDR="192.0.2.2"

# DHCP Server - for automatic configuration on Windows
CONFIG_NET_DHCPV4_SERVER=y
CONFIG_NET_DHCPV4_SERVER_INSTANCES=1
CONFIG_NET_DHCPV4_SERVER_ADDR_COUNT=50
CONFIG_NET_DHCPV4_SERVER_ADDR_LEASE_TIME=7200

# Shell for debugging and network commands
CONFIG_SHELL=y
CONFIG_NET_SHELL=y

# USB Device with RNDIS (Remote Network Driver Interface Specification)
# RNDIS provides better compatibility with Windows than CDC ECM
CONFIG_USB_DEVICE_STACK=y
CONFIG_USB_DEVICE_NETWORK_RNDIS=y
CONFIG_USB_DEVICE_PRODUCT="H723 USB Network (RNDIS)"
CONFIG_USB_DEVICE_MANUFACTURER="Zephyr"

# Network buffers
CONFIG_NET_PKT_RX_COUNT=32
CONFIG_NET_PKT_TX_COUNT=32
CONFIG_NET_BUF_RX_COUNT=64
CONFIG_NET_BUF_TX_COUNT=64

# Stack sizes
CONFIG_MAIN_STACK_SIZE=8192
CONFIG_SYSTEM_WORKQUEUE_STACK_SIZE=8192

# Logging with network debug
CONFIG_LOG=y
CONFIG_LOG_DEFAULT_LEVEL=3
CONFIG_NET_LOG=y
```

## prj-usb-cdc.conf
```kconfig
# Networking
CONFIG_NETWORKING=y
CONFIG_NET_IPV4=y
CONFIG_NET_TCP=y

# USB Device - CDC ACM (sériový port emulace)
CONFIG_USB_DEVICE_STACK=y
CONFIG_USB_CDC_ACM=y
CONFIG_USB_DEVICE_PRODUCT="H723 CDC Serial"
CONFIG_USB_DEVICE_MANUFACTURER="Zephyr Project"

# Static IP 
CONFIG_NET_CONFIG_SETTINGS=y
CONFIG_NET_CONFIG_MY_IPV4_ADDR="192.168.1.100"
CONFIG_NET_CONFIG_MY_IPV4_NETMASK="255.255.255.0"

# Buffery pro síť
CONFIG_NET_PKT_RX_COUNT=16
CONFIG_NET_PKT_TX_COUNT=16
CONFIG_NET_BUF_RX_COUNT=32
CONFIG_NET_BUF_TX_COUNT=32

# Stack
CONFIG_MAIN_STACK_SIZE=4096
CONFIG_SYSTEM_WORKQUEUE_STACK_SIZE=4096

# Logging
CONFIG_LOG=y
CONFIG_LOG_DEFAULT_LEVEL=3
```

## prj-usb.conf
```kconfig
# Networking
CONFIG_NETWORKING=y
CONFIG_NET_IPV4=y
CONFIG_NET_TCP=y

# USB Device Stack + ECM (Ethernet Class Model)
CONFIG_USB_DEVICE_STACK=y
CONFIG_USB_DEVICE_NETWORK_ECM=y
CONFIG_USB_DEVICE_INITIALIZE_AT_BOOT=n
CONFIG_USB_DEVICE_PRODUCT="H723 USB Ethernet"
CONFIG_USB_DEVICE_MANUFACTURER="Zephyr"

# Static IP for USB interface
CONFIG_NET_CONFIG_SETTINGS=y
CONFIG_NET_CONFIG_MY_IPV4_ADDR="192.0.2.1"
CONFIG_NET_CONFIG_MY_IPV4_NETMASK="255.255.255.0"

# Network buffers
CONFIG_NET_PKT_RX_COUNT=16
CONFIG_NET_PKT_TX_COUNT=16
CONFIG_NET_BUF_RX_COUNT=32
CONFIG_NET_BUF_TX_COUNT=32

# Stack
CONFIG_MAIN_STACK_SIZE=4096
CONFIG_SYSTEM_WORKQUEUE_STACK_SIZE=4096

# Logging
CONFIG_LOG=y
CONFIG_LOG_DEFAULT_LEVEL=3
```

## usb.overlay
```dts
/ {
	cdc_ecm_eth0: cdc_ecm_eth0 {
		compatible = "zephyr,cdc-ecm-ethernet";
		remote-mac-address = "00:5E:00:53:01:00";
	};
};
```

## src/main.c
```c
/**
 * @file main.c
 * @brief USB Microcontroller Web Configuration Demo
 * 
 * This application demonstrates a web server running over USB ECM
 * (Ethernet Control Model) on a microcontroller using Zephyr RTOS.
 * The device presents itself as an Ethernet device to the host.
 * Supports configuration of network settings and other parameters via web interface.
 */

#include <zephyr/kernel.h>
#include <zephyr/logging/log.h>
#include "usb_service.h"
#include "web_server.h"

LOG_MODULE_REGISTER(main_app, LOG_LEVEL_INF);

/**
 * @brief Main application entry point
 * 
 * Initializes USB ECM interface and starts the HTTP server.
 * The main thread monitors system health and logs periodic status updates.
 * 
 * @return 0 on success, non-zero on failure
 */
int main(void)
{
    LOG_INF("=== Zephyr USB ECM Web Server Application ===");

    /* Initialize USB ECM service */
    int ret = usb_service_init();
    if (ret < 0) {
        LOG_ERR("USB service initialization failed: %d", ret);
        return 1;
    }

    LOG_INF("USB ECM service initialized");

    /* Start HTTP web server */
    ret = web_server_start();
    if (ret < 0) {
        LOG_ERR("Web server startup failed: %d", ret);
        return 2;
    }

    LOG_INF("Web server started");
    LOG_INF("Ready for connections on http://192.0.2.1:8080");

    /* Main thread - monitor system health */
    while (1) {
        k_sleep(K_SECONDS(10));
        LOG_INF("System alive, uptime: %u seconds", k_uptime_get() / 1000);
    }

    return 0;
}
```

## src/usb_service.c
```c
/**
 * @file usb_service.c
 * @brief USB network service implementation
 *
 * Initializes the USB device network and configures the network interface
 * with a static IPv4 address for host communication.
 */

#include "usb_service.h"
#include <zephyr/usb/usb_device.h>
#include <zephyr/logging/log.h>
#include <zephyr/net/net_if.h>
#include <zephyr/net/net_ip.h>
#include <zephyr/net/dhcpv4_server.h>

LOG_MODULE_REGISTER(usb_service, LOG_LEVEL_INF);

/* Historically USB network interface was at index 2,
 * but this depends on board and configuration.
 */
#define USB_PREFERRED_IF_INDEX 2
#define USB_IF_SCAN_MAX_INDEX  10

/* USB interface pointer cache */
static struct net_if *usb_iface = NULL;

int usb_service_init(void)
{
    /* Initialize USB device */
    if (usb_enable(NULL)) {
        LOG_ERR("USB initialization failed");
        return -1;
    }

    LOG_INF("USB device initialized");

    /* Give network stack time to initialize USB network interface */
    k_sleep(K_SECONDS(2));

    /* Try preferred index first */
    usb_iface = net_if_get_by_index(USB_PREFERRED_IF_INDEX);

    /* Fallback: scan available interfaces */
    if (!usb_iface) {
        for (int i = 1; i <= USB_IF_SCAN_MAX_INDEX; i++) {
            usb_iface = net_if_get_by_index(i);
            if (usb_iface) {
                LOG_WRN("Preferred USB interface index %d not found, using index %d",
                        USB_PREFERRED_IF_INDEX, i);
                break;
            }
        }
    }

    if (!usb_iface) {
        LOG_ERR("USB network interface not found");

        /* Debug: list available interfaces */
        LOG_INF("Available network interfaces:");
        for (int i = 1; i <= USB_IF_SCAN_MAX_INDEX; i++) {
            struct net_if *iface = net_if_get_by_index(i);
            if (iface) {
                LOG_INF("  Index %d: interface available", i);
            }
        }
        return -2;
    }

    LOG_INF("USB network interface selected");

    /* Configure static IPv4 address: 192.0.2.1/24 */
    struct in_addr addr;
    addr.s_addr = htonl((192 << 24) | (0 << 16) | (2 << 8) | 1);

    struct net_if_addr *ifaddr =
        net_if_ipv4_addr_add(usb_iface, &addr, NET_ADDR_MANUAL, 0);

    if (!ifaddr) {
        LOG_ERR("Failed to add IPv4 address to USB interface");
        return -3;
    }

    LOG_INF("IPv4 address 192.0.2.1/24 configured on USB interface");

    /* Start DHCP server for Windows auto-configuration */
    /* DHCP pool: 192.0.2.100 - 192.0.2.150 */
    struct in_addr dhcp_start;
    dhcp_start.s_addr = htonl((192 << 24) | (0 << 16) | (2 << 8) | 100);

    int dhcp_ret = net_dhcpv4_server_start(usb_iface, &dhcp_start);
    if (dhcp_ret < 0) {
        LOG_WRN("DHCP server failed to start: %d (manual configuration may be required on host)",
                dhcp_ret);
    } else {
        LOG_INF("DHCP server started at 192.0.2.1, pool 192.0.2.100-192.0.2.150");
    }

    return 0;
}

struct net_if *usb_service_get_interface(void)
{
    return usb_iface;
}
```

## src/usb_service.h
```c
/**
 * @file usb_service.h
 * @brief USB ECM (Ethernet Control Model) service initialization
 * 
 * Handles USB device initialization and network interface configuration
 * for USB-to-Ethernet connectivity.
 */

#pragma once

#include <zephyr/kernel.h>

/**
 * @brief Initialize USB device and configure network interface
 * 
 * Enables USB device, waits for network initialization, and configures
 * the USB ECM interface with IPv4 address 192.0.2.1/24.
 * 
 * @return 0 on success, negative error code on failure
 */
int usb_service_init(void);

/**
 * @brief Get the USB network interface
 * 
 * @return Pointer to USB network interface, or NULL if not found
 */
struct net_if *usb_service_get_interface(void);
```

## src/web_resources.h
```c
/**
 * @file web_resources.h
 * @brief Web server HTML resources with Bootstrap styling
 * 
 * Modern responsive HTML pages using Bootstrap CSS framework.
 * Uses C preprocessor macros to avoid code duplication while keeping
 * all HTML as static strings (no runtime allocation).
 */

#pragma once

/* Helper macros for string conversion */
#define STRINGIFY(x) #x
#define TOSTRING(x) STRINGIFY(x)

/* Default version if not provided by build system */
#ifndef ZEPHYR_VERSION_STRING
#define ZEPHYR_VERSION_STRING unknown
#endif

/* ============================================================================
 * SHARED COMPONENTS - Used by all pages
 * ============================================================================ */

/**
 * @brief HTML header start - DOCTYPE, charset, meta tags, and CSS styles
 * (note: does not include </head><body> - those are added per page with title)
 */
#define HTML_HEAD_START \
    "<!DOCTYPE html><html><head>" \
    "<meta charset='UTF-8'><meta name='viewport' content='width=device-width,initial-scale=1'>" \
    "<style>" \
    "body{margin:0;font-family:Consolas,Monaco,'Courier New',monospace;background:#1e1e1e;color:#d4d4d4}" \
    ".navbar{background:#252526;padding:.5rem 1rem;color:#d4d4d4;display:flex;justify-content:space-between;align-items:center;border-bottom:1px solid #3c3c3c}" \
    ".navbar-brand{font-size:1.25rem;font-weight:700;color:#569cd6}" \
    ".nav{display:flex;list-style:none;margin:0;padding:0}" \
    ".nav a{color:#d4d4d4;text-decoration:none;padding:.5rem 1rem;display:block}" \
    ".nav a:hover{background:#2d2d30}" \
    ".container{max-width:1200px;margin:0 auto;padding:1rem}" \
    ".row{display:flex;gap:1rem;flex-wrap:wrap}" \
    ".col{flex:1;min-width:200px}" \
    ".card{border:1px solid #3c3c3c;background:#252526;border-radius:6px;padding:1rem;margin-bottom:1rem;box-shadow:0 0 10px rgba(0,0,0,.4)}" \
    ".card-header{font-weight:700;border-bottom:1px solid #3c3c3c;padding-bottom:.5rem;margin-bottom:.5rem;color:#569cd6}" \
    ".btn{display:inline-block;padding:.375rem .75rem;background:#0e639c;color:#ffffff;text-decoration:none;border-radius:4px;border:1px solid #1177bb;cursor:pointer}" \
    ".btn:hover{background:#1177bb}" \
    ".badge{display:inline-block;background:#6a9955;color:#ffffff;padding:.25rem .5rem;border-radius:4px;font-size:.85em}" \
    "h1,h2{color:#569cd6;margin-top:0}" \
    ".footer{text-align:center;padding:1rem;font-size:.875rem;color:#808080;border-top:1px solid #3c3c3c;margin-top:1rem}" \
    ".table{width:100%;border-collapse:collapse;margin-bottom:1.5rem;font-size:.95rem}" \
    ".table th{background:#2d2d30;color:#569cd6;text-align:left;padding:.6rem;border-bottom:2px solid #3c3c3c;font-weight:600}" \
    ".table td{padding:.6rem;border-bottom:1px solid #3c3c3c}" \
    ".table tr:nth-child(even){background:#252526}" \
    ".table tr:hover{background:#2a2d2e}" \
    ".table td:first-child{color:#9cdcfe;width:40%}" \
    ".table td:last-child{color:#ce9178;font-weight:500}" \
    ".form-group{margin-bottom:1rem}" \
    ".form-group label{display:block;margin-bottom:.5rem;color:#9cdcfe;font-weight:600}" \
    ".form-group input,.form-group select{width:100%;padding:.5rem;background:#1e1e1e;color:#d4d4d4;border:1px solid #3c3c3c;border-radius:4px;font-family:inherit}" \
    "</style>"

/**
 * @brief End of head and start of body
 */
#define HTML_HEAD_END \
    "</head><body>"\
     "<title>USB HTTP server demo</title>"

/**
 * @brief Shared navigation bar for all pages
 */
#define HTML_NAVBAR \
    "<div class='navbar'>" \
    "<div class='navbar-brand'>🚀 USB HTTP server demo</div>" \
    "<ul class='nav'>" \
    "<li><a href='/'>Home</a>" \
    "<li><a href='/status'>Status</a>" \
    "<li><a href='/info'>Info</a>" \
    "</ul>" \
    "</div>"

/**
 * @brief Shared page footer for all pages
 */
#define HTML_PAGE_FOOTER \
    "<div class='footer'>USB Web Demo - Zephyr RTOS</div>" \
    "</div></body></html>"

/* ============================================================================
 * PAGE CONTENT - Individual page body content (without structure)
 * ============================================================================ */

#define HTML_INDEX_CONTENT \
    "<div class='container'><h1>USB Connected Device</h1><div class='row'>" \
    "<div class='col'><div class='card'><div class='card-header'>⚙️ RTOS</div>" \
    "<p><strong>System:</strong> Zephyr RTOS</p>" \
    "<p><strong>Interface:</strong> USB Network</p>" \
    "</div></div></div></div>"

#define HTML_STATUS_CONTENT \
    "<div class='container'><h2>System Status</h2>" \
    "<table class='table'><thead><tr><th>System</th><th>Status</th></tr></thead><tbody>" \
    "<tr><td>Network</td><td>192.0.2.1</td></tr>" \
    "<tr><td>Port</td><td>8080 (TCP)</td></tr>" \
    "</tbody></table></div>"

#define HTML_INFO_CONTENT \
    "<div class='container'><h2>Device Info</h2>" \
    "<table class='table'><thead><tr><th>Software</th><th>Version</th></tr></thead><tbody>" \
    "<tr><td>RTOS</td><td>Zephyr " TOSTRING(ZEPHYR_VERSION_STRING) "</td></tr>" \
    "</tbody></table></div>"


#define HTML_NOTFOUND_CONTENT \
    "<div class='container'><h1>404 - Not Found</h1>" \
    "<p>The requested page does not exist.</p>" \
    "<p><a href='/' class='btn'>Back to Home</a></p></div>"

/* ============================================================================
 * COMPLETE PAGES - Assembled from components
 * ============================================================================ */

/**
 * @brief HTML home page - assembled from components
 */
static const char *html_index_page =
    HTML_HEAD_START
    HTML_HEAD_END
    HTML_NAVBAR
    HTML_INDEX_CONTENT
    HTML_PAGE_FOOTER;

/**
 * @brief Status page - assembled from components
 */
static const char *html_status_page =
    HTML_HEAD_START
    HTML_HEAD_END
    HTML_NAVBAR
    HTML_STATUS_CONTENT
    HTML_PAGE_FOOTER;

/**
 * @brief Info page - assembled from components
 */
static const char *html_info_page =
    HTML_HEAD_START
    HTML_HEAD_END
    HTML_NAVBAR
    HTML_INFO_CONTENT
    HTML_PAGE_FOOTER;

/**
 * @brief Configuration page - empty, not used
 */
static const char *html_config_page =
    HTML_HEAD_START
    HTML_HEAD_END
    HTML_NAVBAR
    "<div class='container'><h1>Not Available</h1></div>"
    HTML_PAGE_FOOTER;

/**
 * @brief 404 Not Found page - assembled from components
 */
static const char *html_not_found =
    HTML_HEAD_START
    HTML_HEAD_END
    HTML_NAVBAR
    HTML_NOTFOUND_CONTENT
    HTML_PAGE_FOOTER;
```

## src/web_server.c
```c
/**
 * @file web_server.c
 * @brief HTTP web server implementation
 * 
 * Simple HTTP/1.1 server that accepts connections on port 8080
 * and serves web pages from web_resources.h.
 */

#include "web_server.h"
#include "web_resources.h"
#include <zephyr/kernel.h>
#include <zephyr/net/socket.h>
#include <zephyr/logging/log.h>
#include <string.h>
#include <stdio.h>
#include <errno.h>

LOG_MODULE_REGISTER(web_server, LOG_LEVEL_INF);

/* HTTP server configuration */
#define HTTP_PORT 8080
#define LISTEN_BACKLOG 5
#define HTTP_THREAD_STACK_SIZE 2048
#define REQUEST_BUFFER_SIZE 512
#define RESPONSE_BUFFER_SIZE 32768  /* 32KB - for full HTML pages with extensive CSS */
#define MAX_FILE_PATH 256

/* Thread resources */
static K_THREAD_STACK_DEFINE(http_thread_stack, HTTP_THREAD_STACK_SIZE);
static struct k_thread http_thread_data;

/**
 * @brief Build HTTP response without Content-Length
 * 
 * HTTP response using Connection: close instead of Content-Length.
 * Client will read until connection closes, so no size issues.
 * 
 * @param content HTML content body
 * @param content_type HTTP Content-Type header
 * @param response_buf Output buffer for complete response
 * @param buf_size Size of response buffer
 * @return Number of bytes written to buffer, or -1 on error
 */
static int build_http_response(const char *content, const char *content_type,
                               char *response_buf, size_t buf_size)
{
    if (!content || !response_buf || !content_type) {
        return -1;
    }

    size_t content_len = strlen(content);
    
    /* Build HTTP headers WITHOUT Content-Length - use Connection: close instead */
    int header_len = snprintf(response_buf, buf_size,
        "HTTP/1.1 200 OK\r\n"
        "Content-Type: %s\r\n"
        "Connection: close\r\n"
        "\r\n",
        content_type);

    if (header_len < 0 || header_len >= (int)buf_size) {
        LOG_ERR("Failed to build HTTP headers");
        return -1;
    }

    /* Append content */
    if (header_len + content_len >= buf_size) {
        LOG_ERR("Response buffer too small (have %zu, need %zu)",
                buf_size, header_len + content_len);
        return -1;
    }

    memcpy(response_buf + header_len, content, content_len);
    return header_len + content_len;
}

/**
 * @brief Handle static file requests (CSS, JS, etc)
 * 
 * @param path Requested file path
 * @param content_type Output content type
 * @param response_buf Output response buffer
 * @param buf_size Size of response buffer
 * @return Number of bytes in response, or -1 on error
 */
static int handle_static_file(const char *path, const char **content_type,
                              char *response_buf, size_t buf_size)
{
    /* Simple routing for Bootstrap files */
    const char *file_content = NULL;
    
    /* Bootstrap CSS - minimal inline version for embedded systems */
    if (strcmp(path, "/css/bootstrap.min.css") == 0) {
        *content_type = "text/css";
        file_content = "body{font-family:system-ui,-apple-system,'Segoe UI',Roboto,Arial,sans-serif}"
                      ".navbar{background:#0d6efd}.btn{padding:.375rem .75rem;border-radius:.25rem}"
                      ".card{border:1px solid #ddd;margin:1rem 0}.alert{padding:.75rem;margin:1rem 0}";
        
        size_t content_len = strlen(file_content);
        int header_len = snprintf(response_buf, buf_size,
            "HTTP/1.1 200 OK\r\n"
            "Content-Type: %s\r\n"
            "Connection: close\r\n"
            "\r\n",
            *content_type);
        
        if (header_len > 0 && header_len + content_len < buf_size) {
            memcpy(response_buf + header_len, file_content, content_len);
            return header_len + content_len;
        }
    }
    
    /* Bootstrap JS - stub for now */
    if (strcmp(path, "/js/bootstrap.bundle.min.js") == 0) {
        *content_type = "application/javascript";
        file_content = "/* Bootstrap JS stub - not implemented in embedded version */";
        
        size_t content_len = strlen(file_content);
        int header_len = snprintf(response_buf, buf_size,
            "HTTP/1.1 200 OK\r\n"
            "Content-Type: %s\r\n"
            "Connection: close\r\n"
            "\r\n",
            *content_type);
        
        if (header_len > 0 && header_len + content_len < buf_size) {
            memcpy(response_buf + header_len, file_content, content_len);
            return header_len + content_len;
        }
    }
    
    return -1;
}

/**
 * @brief Build HTTP 404 response
 */
static int build_404_response(char *response_buf, size_t buf_size)
{
    const char *content = html_not_found;
    size_t content_len = strlen(content);
    
    int header_len = snprintf(response_buf, buf_size,
        "HTTP/1.1 404 Not Found\r\n"
        "Content-Type: text/html; charset=UTF-8\r\n"
        "Connection: close\r\n"
        "\r\n",
        content_len);

    if (header_len < 0 || header_len >= (int)buf_size) {
        return -1;
    }

    if (header_len + content_len >= buf_size) {
        return -1;
    }

    memcpy(response_buf + header_len, content, content_len);
    return header_len + content_len;
}

/**
 * @brief Parse HTTP request path from request line
 * 
 * Extracts the path from HTTP request like "GET /index.html HTTP/1.1"
 * 
 * @param request Full HTTP request string
 * @param path Output buffer for parsed path
 * @param path_len Size of path buffer
 * @return 0 on success, -1 on error
 */
static int parse_http_request(const char *request, char *path, size_t path_len)
{
    /* Parse first line: "GET /path HTTP/1.1" */
    const char *start = strchr(request, ' ');
    if (!start) {
        return -1;
    }
    start++; /* Skip space after method */

    const char *end = strchr(start, ' ');
    if (!end) {
        return -1;
    }

    size_t len = end - start;
    if (len >= path_len) {
        return -1;
    }

    strncpy(path, start, len);
    path[len] = '\0';

    return 0;
}

/**
 * @brief HTTP server thread function
 * 
 * Continuously listens for incoming HTTP connections, parses requests,
 * and serves appropriate HTML pages based on the requested path.
 * 
 * @param arg1 Unused argument
 * @param arg2 Unused argument
 * @param arg3 Unused argument
 */
static void http_server_thread(void *arg1, void *arg2, void *arg3)
{
    ARG_UNUSED(arg1);
    ARG_UNUSED(arg2);
    ARG_UNUSED(arg3);

    LOG_INF("HTTP server starting on port %d...", HTTP_PORT);

    /* Create TCP server socket */
    int server_socket = zsock_socket(AF_INET, SOCK_STREAM, IPPROTO_TCP);
    if (server_socket < 0) {
        LOG_ERR("Failed to create socket: %d", errno);
        return;
    }

    /* Configure server address */
    struct sockaddr_in addr = {
        .sin_family = AF_INET,
        .sin_addr.s_addr = htonl(INADDR_ANY),
        .sin_port = htons(HTTP_PORT)
    };

    /* Bind socket to port */
    if (zsock_bind(server_socket, (struct sockaddr *)&addr, sizeof(addr)) < 0) {
        LOG_ERR("Failed to bind socket: %d", errno);
        zsock_close(server_socket);
        return;
    }

    /* Listen for incoming connections */
    if (zsock_listen(server_socket, LISTEN_BACKLOG) < 0) {
        LOG_ERR("Failed to listen: %d", errno);
        zsock_close(server_socket);
        return;
    }

    LOG_INF("HTTP server listening on port %d", HTTP_PORT);
    LOG_INF("Open http://192.0.2.1:%d in your browser", HTTP_PORT);

    /* Response buffer - static allocation for thread safety */
    static char response_buf[RESPONSE_BUFFER_SIZE];

    /* Accept and serve requests */
    while (1) {
        struct sockaddr_in client_addr;
        socklen_t client_addr_len = sizeof(client_addr);

        /* Accept incoming connection */
        int client_socket = zsock_accept(server_socket,
                                         (struct sockaddr *)&client_addr,
                                         &client_addr_len);
        if (client_socket < 0) {
            LOG_ERR("Failed to accept connection: %d", errno);
            continue;
        }

        LOG_INF("Client connected");

        /* Read HTTP request */
        char req_buf[REQUEST_BUFFER_SIZE];
        ssize_t req_len = zsock_recv(client_socket, req_buf, sizeof(req_buf) - 1, 0);
        
        if (req_len > 0) {
            req_buf[req_len] = '\0';
            LOG_DBG("HTTP Request:\n%s", req_buf);

            /* Parse requested path */
            char path[128] = {0};
            const char *content = html_not_found;
            const char *content_type = "text/html; charset=UTF-8";

            if (parse_http_request(req_buf, path, sizeof(path)) == 0) {
                LOG_INF("Requested path: %s", path);

                /* Try static files first (CSS, JS, etc) */
                int static_response = handle_static_file(path, &content_type, response_buf, sizeof(response_buf));
                if (static_response > 0) {
                    /* Static file found and response built */
                    int total_sent = 0;
                    while (total_sent < static_response) {
                        ssize_t sent = zsock_send(client_socket, response_buf + total_sent,
                                                 static_response - total_sent, 0);
                        if (sent < 0) {
                            LOG_ERR("Failed to send response: %d", errno);
                            break;
                        } else if (sent == 0) {
                            break;
                        } else {
                            total_sent += sent;
                        }
                    }
                    zsock_close(client_socket);
                    continue;
                }

                /* Route HTML page requests */
                if (strcmp(path, "/") == 0 || strcmp(path, "/index.html") == 0) {
                    content = html_index_page;
                    LOG_DBG("Serving index page");
                } else if (strcmp(path, "/status") == 0) {
                    content = html_status_page;
                    LOG_DBG("Serving status page");
                } else if (strcmp(path, "/config") == 0) {
                    content = html_config_page;
                    LOG_DBG("Serving config page");
                } else if (strcmp(path, "/info") == 0) {
                    content = html_info_page;
                    LOG_DBG("Serving info page");
                } else {
                    LOG_WRN("Path not found: %s", path);
                    /* Build 404 response */
                    int response_len = build_404_response(response_buf, sizeof(response_buf));
                    if (response_len > 0) {
                        int total_sent = 0;
                        while (total_sent < response_len) {
                            ssize_t sent = zsock_send(client_socket, response_buf + total_sent,
                                                     response_len - total_sent, 0);
                            if (sent < 0) {
                                LOG_ERR("Failed to send response: %d", errno);
                                break;
                            } else if (sent == 0) {
                                break;
                            } else {
                                total_sent += sent;
                            }
                        }
                    }
                    zsock_close(client_socket);
                    continue;
                }
            } else {
                LOG_ERR("Failed to parse HTTP request");
            }

            /* Build complete HTTP response with proper Content-Length */
            int response_len = build_http_response(content, content_type, response_buf, sizeof(response_buf));
            
            if (response_len > 0) {
                /* Send HTTP response - send all data, looping if needed */
                int total_sent = 0;
                while (total_sent < response_len) {
                    ssize_t sent = zsock_send(client_socket, response_buf + total_sent, 
                                             response_len - total_sent, 0);
                    if (sent < 0) {
                        LOG_ERR("Failed to send response: %d", errno);
                        break;
                    } else if (sent == 0) {
                        LOG_WRN("Socket write returned 0 bytes");
                        break;
                    } else {
                        total_sent += sent;
                    }
                }
                LOG_INF("Sent %d bytes to client (total)", total_sent);
            } else {
                LOG_ERR("Failed to build HTTP response");
            }
        }

        zsock_close(client_socket);
    }

    zsock_close(server_socket);
}

int web_server_start(void)
{
    /* Create and start HTTP server thread */
    k_tid_t tid = k_thread_create(&http_thread_data,
                                   http_thread_stack,
                                   HTTP_THREAD_STACK_SIZE,
                                   http_server_thread,
                                   NULL, NULL, NULL,
                                   K_PRIO_PREEMPT(8),
                                   K_USER,
                                   K_NO_WAIT);

    if (tid == NULL) {
        LOG_ERR("Failed to create HTTP server thread");
        return -1;
    }

    return 0;
}
```

## src/web_server.h
```c
/**
 * @file web_server.h
 * @brief HTTP web server interface
 * 
 * Provides a simple HTTP server for web-based communication
 * over USB ECM interface.
 */

#pragma once

/**
 * @brief Start the HTTP web server
 * 
 * Initializes and starts the HTTP server thread on port 8080.
 * The server listens for incoming HTTP connections and serves
 * a simple web page.
 * 
 * @return 0 on success, negative error code on failure
 */
int web_server_start(void);
```
