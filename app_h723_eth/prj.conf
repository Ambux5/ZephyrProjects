## CMakeLists.txt
```
cmake_minimum_required(VERSION 3.20.0)
find_package(Zephyr REQUIRED HINTS $ENV{ZEPHYR_BASE})
project(nucleo_h723zg_app)

# Build main.c with HTTP server and LED control logic
target_sources(app PRIVATE
    src/main.c
    src/led_service.c
    src/web_server.c
)
```

## prj.conf
```kconfig
# Core network
CONFIG_NETWORKING=y
CONFIG_NET_IPV4=y
CONFIG_NET_TCP=y
CONFIG_NET_SOCKETS=y
CONFIG_POSIX_API=y

# Ethernet
CONFIG_NET_L2_ETHERNET=y
CONFIG_ETH_STM32_HAL=y

# DHCP
CONFIG_NET_DHCPV4=y
CONFIG_NET_CONFIG_SETTINGS=y
CONFIG_NET_CONFIG_NEED_IPV4=y
CONFIG_NET_CONFIG_INIT_TIMEOUT=20

# GPIO
CONFIG_GPIO=y

# Logging
CONFIG_LOG=y
CONFIG_NET_LOG=y
CONFIG_LOG_DEFAULT_LEVEL=3

# Stack sizes (important for HTTP)
CONFIG_MAIN_STACK_SIZE=4096
CONFIG_NET_RX_STACK_SIZE=4096
CONFIG_NET_TX_STACK_SIZE=4096
CONFIG_HEAP_MEM_POOL_SIZE=16384
```

## boards/nucleo_h723zg/nucleo_h723zg.overlay
```dts
/* Device tree overlay for NUCLEO-H723ZG board customization */

&zephyr_user {
	/* Define LED0 - LD1 (green LED on board) */
	led0 = &ld1;
};

/* LD1 (green LED on nucleo board) */
&gpiob {
	ld1: led_0 {
		status = "okay";
		compatible = "gpio-leds";
		gpios = <0 GPIO_ACTIVE_HIGH>;
	};
};
```

## src/main.c
```c
#include <zephyr/kernel.h>
#include <zephyr/logging/log.h>
#include "web_server.h"

LOG_MODULE_REGISTER(main_app, LOG_LEVEL_INF);

/* Main application entry point - monitors system health */
int main(void)
{
    LOG_INF("Zephyr RTOS LED Web Demo started");

    /* Main loop - periodically log system uptime */
    while (1) {
        k_sleep(K_SECONDS(10));
        LOG_INF("System alive, uptime: %u seconds",
                k_uptime_get() / 1000);
    }

    return 0;
}
```

## src/led_service.c
```c
#include "led_service.h"
#include <zephyr/drivers/gpio.h>
#include <zephyr/logging/log.h>

LOG_MODULE_REGISTER(led_service, LOG_LEVEL_INF);

/* LED0 GPIO pin configuration from device tree */
#define LED0_NODE DT_ALIAS(led0)
static const struct gpio_dt_spec led = GPIO_DT_SPEC_GET(LED0_NODE, gpios);

/* Message queue for LED commands: holds 10 messages, each 4 bytes aligned */
K_MSGQ_DEFINE(led_msgq, sizeof(led_cmd_t), 10, 4);

/* LED control thread - processes commands from web_server via message queue */
void led_thread(void)
{
    /* Initialize LED GPIO pin as output */
    gpio_pin_configure_dt(&led, GPIO_OUTPUT_INACTIVE);

    led_cmd_t cmd;

    while (1) {
        /* Wait for LED command from message queue */
        if (k_msgq_get(&led_msgq, &cmd, K_FOREVER) == 0) {

            /* Turn LED on */
            if (cmd == LED_CMD_ON) {
                gpio_pin_set_dt(&led, 1);
                LOG_INF("LED ON");
            }

            /* Turn LED off */
            if (cmd == LED_CMD_OFF) {
                gpio_pin_set_dt(&led, 0);
                LOG_INF("LED OFF");
            }
        }
    }
}

/* Define LED thread: 1KB stack, priority 5, starts automatically at boot */
K_THREAD_DEFINE(led_tid, 1024,
                led_thread,
                NULL, NULL, NULL,
                5, 0, 0);
```

## src/led_service.h
```c
#pragma once
#include <zephyr/kernel.h>

/* LED command enumeration for controlling LED state */
typedef enum {
    LED_CMD_ON,   /* Command to turn LED on */
    LED_CMD_OFF   /* Command to turn LED off */
} led_cmd_t;

/* Message queue for LED commands - shared with LED thread */
extern struct k_msgq led_msgq;
```

## src/web_server.c
```c
#include "web_server.h"
#include "led_service.h"

#include <zephyr/kernel.h>
#include <zephyr/net/socket.h>
#include <zephyr/logging/log.h>
#include <string.h>

LOG_MODULE_REGISTER(web_server, LOG_LEVEL_INF);

/* HTTP server listening port */
#define PORT 80

/* HTML response page with LED control buttons */
static const char *html_page =
"HTTP/1.1 200 OK\r\n"
"Content-Type: text/html\r\n\r\n"
"<html><body>"
"<h1>Zephyr RTOS Demo</h1>"
"<form action=\"/on\" method=\"post\">"
"<button type=\"submit\">LED ON</button>"
"</form>"
"<br>"
"<form action=\"/off\" method=\"post\">"
"<button type=\"submit\">LED OFF</button>"
"</form>"
"</body></html>";

/* Web server thread - handles HTTP requests for LED control */
static void web_thread(void)
{
    /* Create TCP socket */
    int server = socket(AF_INET, SOCK_STREAM, IPPROTO_TCP);

    /* Configure server address and port */
    struct sockaddr_in addr = {
        .sin_family = AF_INET,
        .sin_port = htons(PORT),
        .sin_addr.s_addr = INADDR_ANY
    };

    /* Bind socket to address and port */
    bind(server, (struct sockaddr *)&addr, sizeof(addr));
    listen(server, 5);

    LOG_INF("Web server started on port 80");

    /* Accept incoming client connections */
    while (1) {

        int client = accept(server, NULL, NULL);
        if (client < 0) {
            continue;
        }

        /* Receive HTTP request from client */
        char buffer[512];
        int len = recv(client, buffer, sizeof(buffer)-1, 0);

        if (len > 0) {

            buffer[len] = 0;

            /* Check for LED ON request */
            if (strstr(buffer, "POST /on")) {
                led_cmd_t cmd = LED_CMD_ON;
                k_msgq_put(&led_msgq, &cmd, K_NO_WAIT);
            }

            /* Check for LED OFF request */
            if (strstr(buffer, "POST /off")) {
                led_cmd_t cmd = LED_CMD_OFF;
                k_msgq_put(&led_msgq, &cmd, K_NO_WAIT);
            }

            /* Send HTML response page to client */
            send(client, html_page, strlen(html_page), 0);
        }

        close(client);
    }
}

/* Define web server thread: 4KB stack, priority 7, starts automatically at boot */
K_THREAD_DEFINE(web_tid,
                4096,
                web_thread,
                NULL, NULL, NULL,
                7, 0, 0);

/* Web server initialization function (thread created via K_THREAD_DEFINE) */
void web_server_start(void)
{
    /* Automatic thread creation handled by K_THREAD_DEFINE macro */
}
```

## src/web_server.h
```c
#pragma once

/* Start the web server - called during initialization (though thread starts automatically) */
void web_server_start(void);
```
